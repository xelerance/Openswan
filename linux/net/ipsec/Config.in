## linux/net/ipsec/Config.in
```kconfig
#
# IPSEC configuration
# Copyright (C) 1998, 1999, 2000,2001  Richard Guy Briggs.
# Copyright (C) 2004 Michael Richardson <mcr@xelerance.com>
# 
# This program is free software; you can redistribute it and/or modify it
# under the terms of the GNU General Public License as published by the
# Free Software Foundation; either version 2 of the License, or (at your
# option) any later version.  See <http://www.fsf.org/copyleft/gpl.txt>.
# 
# This program is distributed in the hope that it will be useful, but
# WITHOUT ANY WARRANTY; without even the implied warranty of MERCHANTABILITY
# or FITNESS FOR A PARTICULAR PURPOSE.  See the GNU General Public License
# for more details.
#
# RCSID $Id: Config.in,v 1.32 2004/07/15 01:22:19 mcr Exp $

comment 'IPsec options (Openswan)'

bool '   IPsec: IP-in-IP encapsulation (tunnel mode)' CONFIG_KLIPS_IPIP

bool '   IPsec: Authentication Header' CONFIG_KLIPS_AH

bool '   IPsec: Encapsulating Security Payload' CONFIG_KLIPS_ESP

comment '   IPsec algorithms to include'
if [ "$CONFIG_KLIPS_ESP" = "y" ]; then
  bool '      3DES encryption algorithm' CONFIG_KLIPS_ENC_3DES
  bool '       AES encryption algorithm' CONFIG_KLIPS_ENC_AES
fi

if [ "$CONFIG_KLIPS_AH" = "y" -o "$CONFIG_KLIPS_ESP" = "y" ]; then
  bool '      HMAC-MD5 authentication algorithm' CONFIG_KLIPS_AUTH_HMAC_MD5
  bool '      HMAC-SHA1 authentication algorithm' CONFIG_KLIPS_AUTH_HMAC_SHA1
fi


bool '   IPsec Modular Extensions' CONFIG_KLIPS_ALG
if [ "$CONFIG_KLIPS_ALG" != "n" ]; then
	source net/ipsec/alg/Config.in
fi

bool '   IPsec: IP Compression' CONFIG_KLIPS_IPCOMP

bool '   IPsec Debugging Option' CONFIG_KLIPS_DEBUG

#
#
# $Log: Config.in,v $
# Revision 1.32  2004/07/15 01:22:19  mcr
# 	adjustment of AES options for klips24 prep.
#
# Revision 1.31  2004/07/10 19:11:18  mcr
# 	CONFIG_IPSEC -> CONFIG_KLIPS.
#
# Revision 1.30  2004/06/23 09:49:37  ken
# Free -> Open
#
# Revision 1.29  2004/04/06 02:49:25  mcr
# 	pullup of algo code from alg-branch.
#
# Revision 1.28  2004/02/03 03:12:26  mcr
# 	remove NAT-traversal option from IPsec config,
# 	as it should be in the kernel configuration if
# 	the NAT-T patch is installed.
#
# Revision 1.27.2.2  2004/04/05 04:30:46  mcr
# 	patches for alg-branch to compile/work with 2.x openswan
#
# Revision 1.27.2.1  2003/12/23 12:48:25  jjo
#       Added missing alg part to linux/net/ipsec/Config.in
#
# Revision 1.27  2003/12/10 01:14:27  mcr
# 	NAT-traversal patches to KLIPS.
#
# Revision 1.26  2002/04/24 07:36:26  mcr
# Moved from ./klips/net/ipsec/Config.in,v
#
# Revision 1.25  2002/02/21 19:55:12  mcr
# 	removed all traces of IPSEC_CONFIG_REGRESS because it
# 	screwed up 2.2's "make menuconfig" scripts.
#
# Revision 1.24  2002/01/28 20:24:31  mcr
# 	commented out IPSEC_REGRESS option from user visible config.
#
#
```

## linux/net/ipsec/alg/Config.in
```kconfig
#Placeholder
source net/ipsec/alg/Config.alg_aes.in
source net/ipsec/alg/Config.alg_cryptoapi.in
```

## nat-t/net/ipv4/Kconfig.os2_6.patch
```kconfig
--- /distros/kernel/linux-2.6.11.2/net/ipv4/Kconfig	2005-03-09 03:12:33.000000000 -0500
+++ swan26/net/ipv4/Kconfig	2005-04-04 18:46:13.000000000 -0400
@@ -351,2 +351,8 @@
 
+config IPSEC_NAT_TRAVERSAL
+	bool "IPSEC NAT-Traversal (KLIPS compatible)"
+	depends on INET
+	---help---
+          Includes support for RFC3947/RFC3948 NAT-Traversal of ESP over UDP.
+
 config IP_TCPDIAG
```

## ng-patch/net/ipv4/Kconfig.os2_6.patch
```kconfig
commit c0f13aeb0d3eaeac192a7186d678c9b8a635643a
Author: Michael Richardson <mcr@xelerance.com>
Date:   Tue Apr 25 20:50:28 2006 -0400

    KLIPSng patches to rest of kernel.
    Sign-off-by: Michael Richardson <mcr@xelerance.com>

diff --git a/include/linux/in.h b/include/linux/in.h
index ba35538..2b47dff 100644
--- a/include/linux/in.h
+++ b/include/linux/in.h
@@ -367,6 +367,12 @@ config SYN_COOKIES
 
 	  If unsure, say N.
 
+config IPSEC_NAT_TRAVERSAL
+	bool "IPSEC NAT-Traversal (KLIPS compatible)"
+	depends on INET
+	---help---
+          Includes support for RFC3947/RFC3948 NAT-Traversal of ESP over UDP.
+
 config INET_AH
 	tristate "IP: AH transformation"
 	select XFRM
diff --git a/net/ipv4/af_inet.c b/net/ipv4/af_inet.c
index 97c276f..10c2d77 100644
--- a/net/ipv4/af_inet.c
```

## packaging/openwrt/Config.in
```kconfig
config BR2_PACKAGE_LIBRESWAN
	tristate "Libreswan"
	default m
	help
	  Libreswan is an implementation of IPsec for Linux.
```
